/dts-v1/;

/ {
	signature {

		key-dev {
			required = "conf";
			algo = "sha256,rsa4096";
			rsa,r-squared = <0xd5ce5c76 0x3f9b7e8a 0xa922799c 0x7965e5cc 0x95aebc7b 0xc9eb1c44 0xcea49d99 0xecf6aabd 0xe467f4bf 0xefcccbd3 0x598f5722 0x1e0cbdb9 0xfd26e48 0xe130cf38 0xa0a74323 0x56932165 0xe3f714ff 0x9ca5a0e7 0xc50b8dec 0xdb3fa009 0x78e733e2 0x14b8f3aa 0xe2891ee1 0xa0a6745c 0xec72831c 0x85788396 0xffa3d5a7 0x3c81526e 0xec253e38 0x93243de3 0x63a4fd57 0xa1b074d0 0x9ed7a681 0x1355f145 0xda3a7be9 0x6c0c89a8 0x5aeb52cb 0x995cc523 0x88ab9121 0xbc3dcddc 0x28514e10 0x40fd15fb 0xdd055d52 0x88827eba 0x9c889deb 0x6f3dba59 0x793f0c67 0x96a9a4a6 0x29bbdfb8 0x6dc60c6c 0xb2eae620 0xbc492c4f 0x92b2c8d1 0xd20b893d 0x53a05d82 0x10be7685 0xb099ec08 0xd7d1b4e 0x15f02664 0xd4623dba 0x9360efd5 0xfa3b32c7 0xb0228664 0x2c1d657f 0xbf12b957 0x6e483c45 0x6bcdbcdc 0x75c10b16 0xc236d4a8 0x750f5a70 0x1862554d 0xb10d4455 0x84fb444b 0xb8d34020 0xee1d497b 0xd2b8b83c 0x98c3c61 0xdc029c1a 0xc3a56f68 0x72436605 0xae01ea4e 0x1d4b605b 0x8eb0b0a3 0x3257dd64 0xe627a32d 0xc1233f14 0xc56412ac 0x694cd7db 0xe75eb978 0x54e11106 0xf7f103e1 0x6b03081f 0xf2f02a5 0x1a21f061 0xbb23a685 0xd78bf353 0xe3ab2c73 0xb82085af 0xac048d9d 0xe64f4099 0xe4e8d711 0xfaa3b6bf 0x2a42490a 0xf14ba732 0x5007085a 0x1d879f1 0x8af269a3 0xe19b79a4 0x18944a5f 0xb602ee0a 0xeef96f87 0x929714a7 0x132d4e30 0xfeceb266 0xde07b6d6 0x11174b31 0xc0d43fdc 0x15c8c6e6 0x66c07b6d 0x413572eb 0x4446218d 0x2a95497d 0xb3bd8fb2 0x5e7ccf6b 0xb73dff8d 0x4e915980 0x8ba1b193 0xb1301e2b>;
			rsa,modulus = <0xdd702ab9 0xe38d47c2 0x1b31f7fa 0x75d59bfc 0x3832c66c 0xeb1b570 0xf9df309b 0x9fb783d2 0x5a01ad85 0x907b54b7 0xb1078b54 0xffb024dd 0xb7063479 0x1a8eb4be 0x92aa5df0 0x932eb734 0xd4121444 0x50b8711f 0x66ca4a26 0x213761dc 0xc010e6ae 0x1926a679 0xa2ed3c51 0x4f641aac 0xf51d2356 0x3411bb6 0x6b26c3e6 0x567e063d 0xd6db6ad4 0xd1bc60be 0x47f69b2 0x223fe0e8 0xa5aee659 0x78f5094f 0x4d1f33da 0xfbc13e22 0xf2bfe2e7 0x68fb8b3f 0xe4b0a5fc 0xe47ac6d1 0x738fc71d 0x59b22196 0xb3c5259e 0x7b3a781d 0xf0bcd4a1 0xff1773d8 0x7c285d14 0x7298bc54 0x921a3de4 0x549b1c56 0x83f6c912 0xefd4adf2 0x8442d252 0xcd50125c 0x5a3eda27 0xf34bda18 0x9f12113e 0x635cbb30 0x2fc52499 0xeb59fedf 0xcb563de3 0x6711dc7 0x7e6cf3a2 0x651b5aed 0x33ba861c 0xce5b6837 0x3ef91e7 0x1db8c6ee 0xefeaba89 0x73c70019 0xe22188d1 0x9ec21e86 0xb55ebdb6 0x6d9403c7 0x3399732a 0x15fc6807 0x81ff9e42 0xb6525f77 0x7b07323d 0xab6ec4e 0x5847e44b 0xc6002cd2 0xf9d2687e 0x84a8ab1d 0x6d8af41e 0x49e8766a 0xf809f858 0xe0f7da2e 0x2f2c2035 0x1e723d8a 0x57511f54 0xfe37a5d1 0xba3e1d46 0x43a3eec5 0x3949213d 0xaf9a9f69 0xf5da65a3 0x2d000dcd 0xa1673789 0xb4d81c43 0x6f93bebc 0x7b617ad3 0x9641a511 0x333ae27f 0x49ae14eb 0xc6d36917 0x43fc3cf9 0xb2fe61c9 0xf11c9d13 0xe39b9e09 0x62fe6643 0xd28e0cad 0xc31bb66e 0x9616e5d 0xb895235f 0xa8a331ce 0x931e96e2 0xef66dd09 0x195c1c6a 0xccfaa9a5 0x51f9f11b 0x6a080a0b 0xa62601aa 0xc068b452 0xa26831ca 0xa8a62a48 0xa79f7cae 0x7ec2d5b3>;
			rsa,exponent = <0x0 0x10001>;
			rsa,n0-inverse = <0x8b541e85>;
			rsa,num-bits = <0x1000>;
			key-name-hint = "dev";
		};

	};
};
